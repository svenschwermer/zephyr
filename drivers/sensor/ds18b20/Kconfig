## drivers/sensor/ds18b20/Kconfig
```kconfig
# Kconfig - Maxim DS18B20 Programmable Resolution 1-Wire Digital Thermometer

#
# Copyright (c) 2019 Sven Schwermer
#
# SPDX-License-Identifier: Apache-2.0
#

menuconfig DS18B20
	bool "Maxim DS18B20 1-Wire temperature sensor"
	depends on W1
	help
	  Enable Maxim DS18B20 Programmable Resolution 1-Wire Digital Thermometer.

if DS18B20

config DS18B20_NAME
	string "Driver name"
	default "TEMP_0"
	help
	  Name for the device instance of the DS18B20 driver.

config DS18B20_W1_INST
	string "1-Wire bus name"
	default "W1_0"
	help
	  Name for the device instance 1-Wire bus driver.

endif # DS18B20
```

## drivers/w1/Kconfig
```kconfig
# Kconfig - 1-Wire driver configuration options

#
# Copyright (c) 2019 Sven Schwermer
#
# SPDX-License-Identifier: Apache-2.0
#

#
# 1-Wire Drivers
#
menuconfig W1
	bool "1-Wire bus support"
	help
	  Enable support for the 1-Wire bus.

if W1

config W1_INIT_PRIORITY
	int "Init priority"
	default 70
	help
	  Device driver initialization priority.

module = 1-Wire
module-str = w1
source "subsys/logging/Kconfig.template.log_config"

source "drivers/w1/Kconfig.nrfx"

endif # W1
```

## drivers/w1/Kconfig.gpio
```kconfig
# Kconfig.w1_gpio - GPIO 1-Wire driver configuration options

#
# Copyright (c) 2019 Sven Schwermer
#
# SPDX-License-Identifier: Apache-2.0
#

menuconfig W1_GPIO
	bool "GPIO 1-Wire controller driver"
	depends on GPIO
	help
	  Enable support for GPIO 1-Wire bus master controllers.

if W1_GPIO

endif # W1_GPIO
```

## drivers/w1/Kconfig.nrfx
```kconfig
# Copyright (c) 2019 Sven Schwermer
#
# SPDX-License-Identifier: Apache-2.0
#

menuconfig W1_NRFX
	bool "nRF 1-Wire bitbanging driver"
	depends on SOC_FAMILY_NRF
	help
	  Enable 1-Wire bitbanging driver for nRF line of MCUs.

if W1_NRFX

config W1_NRFX_NAME
	string "Driver name"
	default "W1_0"
	help
	  Name for the device instance of the nRF 1-Wire bitbanging driver.

choice W1_NRFX_GPIO_INST
	prompt "GPIO port"
	help
	  GPIO port that the 1-Wire bus is connected to.

config W1_NRFX_GPIO_0
	bool "nRF GPIO Port P0"
	depends on HAS_HW_NRF_GPIO0

config W1_NRFX_GPIO_1
	bool "nRF GPIO Port P1"
	depends on HAS_HW_NRF_GPIO1

endchoice

config W1_NRFX_GPIO_PIN
	int "GPIO pin number"
	help
	  GPIO pin that the 1-Wire bus is connected to.


endif # W1_NRFX
```

## dts/bindings/sensor/maxim,ds18b20.yaml
```yaml
#
# Copyright (c) 2019 Sven Schwermer
#
# SPDX-License-Identifier: Apache-2.0
#
---
title: DS18B20 Programmable Resolution 1-Wire Digital Thermometer
version: 0.1

description: >
    This is a representation of the DS18B20 1-Wire temperature sensor

inherits:
    !include w1-device.yaml

properties:
    compatible:
      constraint: "maxim,ds18b20"
...
```

## dts/bindings/w1/w1-device.yaml
```yaml
#
# Copyright (c) 2019 Sven Schwermer
#
# SPDX-License-Identifier: Apache-2.0
#
---
title: 1-Wire Device Base Structure
version: 0.1

description: >
    This binding gives the base structures for all 1-Wire devices

parent:
    bus: onewire

properties:
    compatible:
      type: string
      category: required
      description: compatible strings
      generation: define
    label:
      type: string
      category: required
      description: Human readable string describing the device (used by Zephyr for API name)
      generation: define
    serial-number:
      type: array
      category: optional
      description: serial number
      generation: define
...
```

## dts/bindings/w1/w1-gpio.yaml
```yaml
#
# Copyright (c) 2019 Sven Schwermer
#
# SPDX-License-Identifier: Apache-2.0
#
---
title: 1-Wire GPIO bus master
version: 0.1

description: >
    This is a representation of a bit-banged 1-Wire bus master

child:
    bus: onewire

properties:
    compatible:
      type: string
      category: required
      description: compatible strings
      constraint: "w1-gpio"
      generation: define
    label:
      type: string
      category: optional
      description: Human readable string describing the device (used by Zephyr for API name)
      generation: define
    gpios:
      type: compound
      category: required
      generation: define
...
```
